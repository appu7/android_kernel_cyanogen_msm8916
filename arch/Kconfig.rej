## arch/Kconfig.rej
```kconfig
--- arch/Kconfig
+++ arch/Kconfig
@@ -404,6 +404,12 @@ config CLONE_BACKWARDS2
 	help
 	  Architecture has the first two arguments of clone(2) swapped.
 
+config CLONE_BACKWARDS3
+	bool
+	help
+	  Architecture has tls passed as the 3rd argument of clone(2),
+	  not the 5th one.
+
 config ODD_RT_SIGACTION
 	bool
 	help
```

## arch/arm64/hotplug/Kconfig
```kconfig
config INTELLI_HOTPLUG
	bool "Intelli hotplug driver"
	depends on HOTPLUG_CPU
	default y
	help
	  An intelligent cpu hotplug driver for
	  Low Latency Frequency Transition capable processors.

config ASMP
	bool "Multi-core automatic hotplug support"
	depends on SMP
	default n
	help
           Automatically hotplugs the multiple cpu cores on and off based on cpu load and suspend state.

config BRICKED_HOTPLUG
 	   bool "Enable kernel based mpdecision"
 	   depends on MSM_RUN_QUEUE_STATS
	   
config ALUCARD_HOTPLUG
	bool "Enable alucard-hotplug cpu hotplug driver"
 	default n
 	help
 	  Generic Alucard-hotplug cpu hotplug driver for ARM SOCs
```

## arch/mn10300/Kconfig.rej
```kconfig
--- arch/mn10300/Kconfig
+++ arch/mn10300/Kconfig
@@ -2,6 +2,7 @@ config MN10300
 	def_bool y
 	select HAVE_OPROFILE
 	select HAVE_GENERIC_HARDIRQS
+	select HAVE_UID16
 	select GENERIC_IRQ_SHOW
 	select ARCH_WANT_IPC_PARSE_VERSION
 	select HAVE_ARCH_TRACEHOOK
@@ -37,9 +38,6 @@ config HIGHMEM
 config NUMA
 	def_bool n
 
-config UID16
-	def_bool y
-
 config RWSEM_GENERIC_SPINLOCK
 	def_bool y
 
```

## arch/openrisc/Kconfig.rej
```kconfig
--- arch/openrisc/Kconfig
+++ arch/openrisc/Kconfig
@@ -17,6 +17,7 @@ config OPENRISC
 	select GENERIC_IRQ_SHOW
 	select GENERIC_IOMAP
 	select GENERIC_CPU_DEVICES
+	select HAVE_UID16
 	select GENERIC_ATOMIC64
 	select GENERIC_CLOCKEVENTS
 	select GENERIC_STRNCPY_FROM_USER
@@ -29,9 +30,6 @@ config MMU
 config HAVE_DMA_ATTRS
 	def_bool y
 
-config UID16
-	def_bool y
-
 config RWSEM_GENERIC_SPINLOCK
 	def_bool y
 
```
